## sdkconfig.defaults
```kconfig
# FreeRTOS
CONFIG_FREERTOS_SUPPORT_STATIC_ALLOCATION=y
CONFIG_FREERTOS_UNICORE=n
CONFIG_FREERTOS_TIMER_TASK_STACK_DEPTH=4096
CONFIG_FREERTOS_ISR_STACK_SIZE=1536

# Wi-Fi / Network
CONFIG_LWIP_SNTP=y
CONFIG_LWIP_DHCP_GET_NTP_SRV=y

# Bluetooth disabled to save DRAM
CONFIG_BT_ENABLED=n

# TLS / mbedTLS
CONFIG_MBEDTLS_DYNAMIC_BUFFER=1
CONFIG_MBEDTLS_DYNAMIC_FREE_PEER_CERT=y
CONFIG_MBEDTLS_DYNAMIC_FREE_CONFIG_DATA=y

# Flash / Partition
CONFIG_ESPTOOLPY_FLASHSIZE_4MB=y
CONFIG_PARTITION_TABLE_CUSTOM=y
CONFIG_PARTITION_TABLE_CUSTOM_FILENAME="partitions.csv"
CONFIG_PARTITION_TABLE_FILENAME="partitions.csv"

# Log level at build time (can be changed at runtime)
CONFIG_LOG_DEFAULT_LEVEL_INFO=y

# Compiler optimizations for size
CONFIG_COMPILER_OPTIMIZATION_SIZE=y
```
